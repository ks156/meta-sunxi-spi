## conf/layer.conf
```bitbake
BBPATH .= ":${LAYERDIR}"

# We have recipes-* directories, add to BBFILES
BBFILES += "${LAYERDIR}/recipes-*/*/*.bb \
            ${LAYERDIR}/recipes-*/*/*.bbappend"

BBFILE_COLLECTIONS += "meta-sunxi-spi"
BBFILE_PATTERN_meta-sunxi-spi = "^${LAYERDIR}/"
BBFILE_PRIORITY_meta-sunxi-spi = "6"

LAYERDEPENDS_meta-sunxi-spi = "sunxi"
LAYERSERIES_COMPAT_meta-sunxi-spi = "scarthgap"
```
